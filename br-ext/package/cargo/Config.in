## br-ext/package/cargo/Config.in
```kconfig
config BR2_PACKAGE_CARGO
	bool "cargo"
	select BR2_PACKAGE_HOST_RUSTC_TARGET_ARCH_SUPPORTS
	select BR2_PACKAGE_HOST_RUSTC
	help
	  https://crates.io/crates/cargo

config BR2_PACKAGE_CARGO_SITE
	string "Cargo path"
	default ""
	help
	  The path to the source directory of Cargo
```

## br-ext/package/kmgk_ext/Config.in
```kconfig
config BR2_PACKAGE_KMGK_EXT
	bool "kmgk"
	help
	  http://github.org/linaro-swg/kmgk

config BR2_PACKAGE_KMGK_EXT_SITE
	string "kmgk path"
	default ""
	help
	  The path to the source directory of kmgk

if BR2_PACKAGE_KMGK_EXT

config BR2_PACKAGE_KMGK_EXT_SDK
	string "OPTEE SDK path"
	default ""
	help
	  some help

config BR2_PACKAGE_KMGK_EXT_CROSS_COMPILE
	string "OPTEE cross compiler"
	default ""
	help
	  some help

endif
```

## br-ext/package/parsec-service/Config.in
```kconfig
config BR2_PACKAGE_PARSEC_SERVICE
	bool "parsec-service"
	select BR2_PACKAGE_HOST_RUSTC_TARGET_ARCH_SUPPORTS
	select BR2_PACKAGE_HOST_RUSTC
	select BR2_PACKAGE_HOST_CARGO
	help
	  https://crates.io/crates/parsec-service

config BR2_PACKAGE_PARSEC_SERVICE_SITE
	string "Parsec service path"
	default ""
	help
	  The path to the source directory of Parsec service
```

## br-ext/package/parsec-tool/Config.in
```kconfig
config BR2_PACKAGE_PARSEC_TOOL
	bool "parsec-tool"
	select BR2_PACKAGE_HOST_RUSTC_TARGET_ARCH_SUPPORTS
	select BR2_PACKAGE_HOST_RUSTC
	select BR2_PACKAGE_HOST_CARGO
	help
	  https://crates.io/crates/parsec-tool

config BR2_PACKAGE_PARSEC_TOOL_SITE
	string "Parsec tool path"
	default ""
	help
	  The path to the source directory of Parsec tool
```
